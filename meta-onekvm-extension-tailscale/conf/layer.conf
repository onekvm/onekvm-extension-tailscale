## meta-onekvm-extension-tailscale/conf/layer.conf
```bitbake
BBPATH .= ":${LAYERDIR}"

BBFILES += "${LAYERDIR}/recipes-*/*/*.bb \
            ${LAYERDIR}/recipes-*/*/*.bbappend"

BBFILE_COLLECTIONS += "onekvm-extension-tailscale"
BBFILE_PATTERN_onekvm-extension-tailscale := "^${LAYERDIR}/"
BBFILE_PRIORITY_onekvm-extension-tailscale = "8"

LAYERDEPENDS_onekvm-extension-tailscale = "core onekvm networking-layer"
LAYERSERIES_COMPAT_onekvm-extension-tailscale = "wrynose"
```
